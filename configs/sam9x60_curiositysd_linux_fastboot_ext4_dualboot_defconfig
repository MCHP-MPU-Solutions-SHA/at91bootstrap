## configs/sam9x60_curiositysd_linux_fastboot_ext4_dualboot_defconfig
```kconfig
CONFIG_SAM9X60=y
# CONFIG_SCLK is not set
CONFIG_DDRC=y
CONFIG_DDR_SET_BY_DEVICE=y
CONFIG_DDR_W971GG6SB=y
CONFIG_SDCARD=y
CONFIG_SDHC_ASYNC_READ=y
CONFIG_LOAD_LINUX=y
CONFIG_OVERRIDE_CMDLINE=y
CONFIG_ARG_DELAY=""
CONFIG_ARG_MEMTEST=""
CONFIG_ARG_MTD=""
CONFIG_ARG_PRINTK=""
CONFIG_ARG_ROOTFSTYPE=" rootfstype=ext4"
CONFIG_ARG_ROOTWAIT=" rootwait cma=16m quiet"
CONFIG_UNC_IMAGE=y
CONFIG_OF_OVERRIDE_DTB_NAME="at91-sam9x60_curiosity.dtb"
CONFIG_OF_ADDRESS="0x22000000"
CONFIG_DUAL_BOOT=y
CONFIG_BOARD_QUIRK_SAM9X60_CURIOSITY=y
```
