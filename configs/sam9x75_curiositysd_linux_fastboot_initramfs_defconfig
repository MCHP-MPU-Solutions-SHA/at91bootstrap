## configs/sam9x75_curiositysd_linux_fastboot_initramfs_defconfig
```kconfig
CONFIG_SAM9X7=y
# CONFIG_SCLK is not set
CONFIG_DDR_SET_BY_DEVICE=y
CONFIG_DDR_W632GU6NG=y
CONFIG_SDCARD=y
CONFIG_SDHC_ASYNC_READ=y
CONFIG_SDHC_ASYNC_READ_QUEUE_SIZE="256"
CONFIG_LOAD_LINUX=y
CONFIG_OVERRIDE_CMDLINE=y
CONFIG_ARG_DELAY=""
CONFIG_ARG_MEMTEST=""
CONFIG_ARG_MTD=""
CONFIG_ARG_PRINTK=""
CONFIG_ARG_ROOT=""
CONFIG_ARG_ROOTFSTYPE=""
CONFIG_ARG_ROOTWAIT=""
CONFIG_ARG_RW=" quiet"
CONFIG_UNC_IMAGE=y
CONFIG_OF_OVERRIDE_DTB_NAME="at91-sam9x75_curiosity.dtb"
CONFIG_BOARD_QUIRK_SAM9X75_CURIOSITY=y
# CONFIG_XDMAC is not set
CONFIG_XLCDC=y
CONFIG_LOGO=y
CONFIG_LOGO_SCALE="4"
```

## configs/sam9x75_curiositysd_linux_fastboot_yocto_defconfig
```kconfig
CONFIG_SAM9X7=y
# CONFIG_SCLK is not set
CONFIG_DDR_SET_BY_DEVICE=y
CONFIG_DDR_W632GU6NG=y
CONFIG_SDCARD=y
CONFIG_SDHC_ASYNC_READ=y
CONFIG_SDHC_ASYNC_READ_QUEUE_SIZE="256"
CONFIG_LOAD_LINUX=y
CONFIG_OVERRIDE_CMDLINE=y
CONFIG_ARG_CMA=" cma=128m"
CONFIG_ARG_DELAY=""
CONFIG_ARG_MEMTEST=""
CONFIG_ARG_MTD=""
CONFIG_ARG_PRINTK=""
CONFIG_ARG_ROOTFSTYPE=" rootfstype=ext4"
CONFIG_ARG_RW=" rw atmel.pm_modes=standby,ulp0"
CONFIG_UNC_IMAGE=y
CONFIG_OF_OVERRIDE_DTB_NAME="at91-sam9x75_curiosity.dtb"
CONFIG_BOARD_QUIRK_SAM9X75_CURIOSITY=y
# CONFIG_XDMAC is not set
CONFIG_XLCDC=y
CONFIG_LOGO=y
CONFIG_LOGO_SCALE="4"
```

## configs/sama7g5eksd_linux_image_dt_hibernation_fastboot_defconfig
```kconfig
CONFIG_SAMA7G5=y
# CONFIG_SCLK is not set
CONFIG_CPU_CLK_800MHZ=y
CONFIG_DEBUG=y
CONFIG_DDR_SET_BY_DEVICE=y
CONFIG_DDR_AS4C256M16D3LC_12BCNTR=y
CONFIG_MEM_CLOCK_533=y
CONFIG_SDCARD=y
CONFIG_SDHC1=y
CONFIG_SDHC_ASYNC_READ=y
CONFIG_LOAD_LINUX=y
CONFIG_OVERRIDE_CMDLINE=y
CONFIG_LINUX_KERNEL_ARG_STRING="CONFIG_ARG_CONSOLE CONFIG_ARG_MTD CONFIG_ARG_ROOT CONFIG_ARG_ROOTFSTYPE CONFIG_ARG_DELAY CONFIG_ARG_RW CONFIG_ARG_ROOTWAIT CONFIG_ARG_CMA CONFIG_ARG_PRINTK"
CONFIG_ARG_DELAY=""
CONFIG_ARG_MEMTEST=""
CONFIG_ARG_MTD=""
CONFIG_ARG_PRINTK=""
CONFIG_ARG_ROOTFSTYPE=" rootfstype=ext4"
CONFIG_ARG_ROOTWAIT=" rootwait resume=/dev/mmcblk1p3 resumewait atmel.pm_modes=standby,ulp0"
CONFIG_OF_OVERRIDE_DTB_NAME="at91-sama7g5ek.dtb"
CONFIG_IMAGE_NAME="zImage"
# CONFIG_REDIRECT_ALL_INTS_AIC is not set
CONFIG_TZC400=y
CONFIG_BACKUP_MODE=y
CONFIG_BOARD_QUIRK_SAMA7G5_EK=y
CONFIG_LED_ON_BOARD=y
CONFIG_LED_R_ON_PIOB=y
CONFIG_LED_R_PIN=8
CONFIG_LED_G_ON_PIOA=y
CONFIG_LED_G_PIN=13
CONFIG_LED_B_ON_PIOD=y
CONFIG_LED_B_PIN=20
CONFIG_FLEXCOM1=y
CONFIG_FLEXCOM1_IOSET=4
CONFIG_MCP16502=y
CONFIG_MCP16502_SET_VOLTAGE=y
CONFIG_VOLTAGE_OUT1=3300
CONFIG_VOLTAGE_OUT2=1350
CONFIG_VOLTAGE_OUT3=1150
CONFIG_VOLTAGE_OUT4=1150
CONFIG_VOLTAGE_LDO1=1800
CONFIG_VOLTAGE_LDO2=1800
CONFIG_WDTS=y
CONFIG_SHDWC=y
```
